## boards/arm/daertwing/Kconfig.defconfig
```kconfig
# Copyright (c) 2025 The ZMK Contributors
# SPDX-License-Identifier: MIT

if BOARD_DAERTWING

config ZMK_KEYBOARD_NAME
    default "Daertwing"

config RP2_FLASH_W25Q080
    default y

endif # BOARD_DAERTWING
```
